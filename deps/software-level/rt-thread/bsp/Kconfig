## deps/software-level/rt-thread/bsp/Kconfig
```kconfig
mainmenu "RT-Thread Configuration"

BSP_DIR := .

RTT_DIR := ../

PKGS_DIR := packages

source "$(RTT_DIR)/Kconfig"
osource "$PKGS_DIR/Kconfig"
rsource "board/Kconfig"

config ALIOTH_SOC
    bool
    select ARCH_RISCV
    select RT_USING_COMPONENTS_INIT
    select RT_USING_USER_MAIN
    default y
```

## deps/software-level/rt-thread/libcpu/Kconfig
```kconfig
config ARCH_RISCV
    bool

config ARCH_RISCV_FPU
    bool

config ARCH_RISCV_VECTOR
    bool

    if ARCH_RISCV_VECTOR
        choice
            prompt "RISCV Vector Vlen"
            default ARCH_VECTOR_VLEN_128

            config ARCH_VECTOR_VLEN_128
                bool "128"
            config ARCH_VECTOR_VLEN_256
                bool "256"
        endchoice
    endif

config ARCH_RISCV_FPU_S
    select ARCH_RISCV_FPU
    bool

config ARCH_RISCV_FPU_D
    select ARCH_RISCV_FPU
    bool

config ARCH_RISCV32
    select ARCH_RISCV
    bool
```

## deps/tools/env_tools/packages/sdk/Windows/aarch64-linux-musleabi-gcc/Kconfig
```kconfig
# Kconfig file for package aarch64-linux-musleabi-gcc
menuconfig PKG_USING_AARCH64_LINUX_MUSLEABI_GCC
    bool "aarch64-linux-musleabi-gcc toolchain (for smart)"
    default n

if PKG_USING_AARCH64_LINUX_MUSLEABI_GCC

    config PKG_AARCH64_LINUX_MUSLEABI_GCC_PATH
        string
        default "sdk/Windows/aarch64-linux-musleabi-gcc"

    choice
        prompt "Version"
        help
            Select the package version

        config PKG_USING_AARCH64_LINUX_MUSLEABI_GCC_LATEST
            bool "latest"
    endchoice

    config PKG_AARCH64_LINUX_MUSLEABI_GCC_VER
       string
       default "latest"   if PKG_USING_AARCH64_LINUX_MUSLEABI_GCC_LATEST

endif
```

## deps/tools/env_tools/packages/sdk/Windows/arm-linux-musleabi-gcc/Kconfig
```kconfig
# Kconfig file for package arm-linux-musleabi-gcc
menuconfig PKG_USING_ARM_LINUX_MUSLEABI_GCC
    bool "arm-linux-musleabi-gcc toolchain (for smart)"
    default n

if PKG_USING_ARM_LINUX_MUSLEABI_GCC

    config PKG_ARM_LINUX_MUSLEABI_GCC_PATH
        string
        default "sdk/Windows/arm-linux-musleabi-gcc"

    choice
        prompt "Version"
        help
            Select the package version

        config PKG_USING_ARM_LINUX_MUSLEABI_GCC_LATEST
            bool "latest"

    endchoice

    config PKG_ARM_LINUX_MUSLEABI_GCC_VER
       string
       default "latest"      if PKG_USING_ARM_LINUX_MUSLEABI_GCC_LATEST

endif
```

## deps/tools/env_tools/packages/sdk/Windows/riscv64-linux-musleabi-gcc/Kconfig
```kconfig
# Kconfig file for package riscv64-linux-musleabi-gcc
menuconfig PKG_USING_RISCV_LINUX_MUSLEABI_GCC
    bool "riscv64-linux-musleabi-gcc toolchain (for smart)"
    default n

if PKG_USING_RISCV_LINUX_MUSLEABI_GCC

    config PKG_RISCV_LINUX_MUSLEABI_GCC_PATH
        string
        default "sdk/Windows/riscv64-linux-musleabi-gcc"

    choice
        prompt "Version"
        help
            Select the package version

        config PKG_USING_RISCV_LINUX_MUSLEABI_GCC_LATEST
            bool "latest"

    endchoice

    config PKG_RISCV_LINUX_MUSLEABI_GCC_VER
       string
       default "latest" if PKG_USING_RISCV_LINUX_MUSLEABI_GCC_LATEST

endif
```
